## Assignement03/Assignement_C/application/build/Kconfig/arch/Kconfig
```kconfig
# Load arch Kconfig descriptions.
osource "/home/pedro/zephyrproject/zephyr/arch/x86/Kconfig"
osource "/home/pedro/zephyrproject/zephyr/arch/xtensa/Kconfig"
osource "/home/pedro/zephyrproject/zephyr/arch/sparc/Kconfig"
osource "/home/pedro/zephyrproject/zephyr/arch/riscv/Kconfig"
osource "/home/pedro/zephyrproject/zephyr/arch/posix/Kconfig"
osource "/home/pedro/zephyrproject/zephyr/arch/nios2/Kconfig"
osource "/home/pedro/zephyrproject/zephyr/arch/mips/Kconfig"
osource "/home/pedro/zephyrproject/zephyr/arch/arm64/Kconfig"
osource "/home/pedro/zephyrproject/zephyr/arch/arm/Kconfig"
osource "/home/pedro/zephyrproject/zephyr/arch/arc/Kconfig"
```

## Assignement03/Assignement_C/application/build/Kconfig/soc/Kconfig
```kconfig
# Load Zephyr SoC Kconfig descriptions.
osource "/home/pedro/zephyrproject/zephyr/soc/xlnx/zynqmp/Kconfig"
osource "/home/pedro/zephyrproject/zephyr/soc/xlnx/zynq7000/Kconfig"
osource "/home/pedro/zephyrproject/zephyr/soc/xen/Kconfig"
osource "/home/pedro/zephyrproject/zephyr/soc/ti/simplelink/Kconfig"
osource "/home/pedro/zephyrproject/zephyr/soc/ti/lm3s6965/Kconfig"
osource "/home/pedro/zephyrproject/zephyr/soc/ti/k3/Kconfig"
osource "/home/pedro/zephyrproject/zephyr/soc/telink/tlsr/Kconfig"
osource "/home/pedro/zephyrproject/zephyr/soc/starfive/jh71xx/Kconfig"
osource "/home/pedro/zephyrproject/zephyr/soc/st/stm32/Kconfig"
osource "/home/pedro/zephyrproject/zephyr/soc/snps/qemu_arc/Kconfig"
osource "/home/pedro/zephyrproject/zephyr/soc/snps/nsim/Kconfig"
osource "/home/pedro/zephyrproject/zephyr/soc/snps/hsdk4xd/Kconfig"
osource "/home/pedro/zephyrproject/zephyr/soc/snps/hsdk/Kconfig"
osource "/home/pedro/zephyrproject/zephyr/soc/snps/emsk/Kconfig"
osource "/home/pedro/zephyrproject/zephyr/soc/snps/emsdp/Kconfig"
osource "/home/pedro/zephyrproject/zephyr/soc/snps/arc_iot/Kconfig"
osource "/home/pedro/zephyrproject/zephyr/soc/silabs/Kconfig"
osource "/home/pedro/zephyrproject/zephyr/soc/sifive/sifive_freedom/Kconfig"
osource "/home/pedro/zephyrproject/zephyr/soc/rockchip/Kconfig"
osource "/home/pedro/zephyrproject/zephyr/soc/renode/riscv_virtual/Kconfig"
osource "/home/pedro/zephyrproject/zephyr/soc/renesas/smartbond/Kconfig"
osource "/home/pedro/zephyrproject/zephyr/soc/renesas/rzt2m/Kconfig"
osource "/home/pedro/zephyrproject/zephyr/soc/renesas/rcar/Kconfig"
osource "/home/pedro/zephyrproject/zephyr/soc/renesas/ra/Kconfig"
osource "/home/pedro/zephyrproject/zephyr/soc/raspberrypi/Kconfig"
osource "/home/pedro/zephyrproject/zephyr/soc/quicklogic/eos_s3/Kconfig"
osource "/home/pedro/zephyrproject/zephyr/soc/qemu/virt_riscv/Kconfig"
osource "/home/pedro/zephyrproject/zephyr/soc/qemu/malta/Kconfig"
osource "/home/pedro/zephyrproject/zephyr/soc/openisa/rv32m1/Kconfig"
osource "/home/pedro/zephyrproject/zephyr/soc/nxp/s32/Kconfig"
osource "/home/pedro/zephyrproject/zephyr/soc/nxp/rw/Kconfig"
osource "/home/pedro/zephyrproject/zephyr/soc/nxp/mcx/Kconfig"
osource "/home/pedro/zephyrproject/zephyr/soc/nxp/lpc/Kconfig"
osource "/home/pedro/zephyrproject/zephyr/soc/nxp/layerscape/Kconfig"
osource "/home/pedro/zephyrproject/zephyr/soc/nxp/kinetis/Kconfig"
osource "/home/pedro/zephyrproject/zephyr/soc/nxp/imxrt/Kconfig"
osource "/home/pedro/zephyrproject/zephyr/soc/nxp/imx/Kconfig"
osource "/home/pedro/zephyrproject/zephyr/soc/nuvoton/numicro/Kconfig"
osource "/home/pedro/zephyrproject/zephyr/soc/nuvoton/numaker/Kconfig"
osource "/home/pedro/zephyrproject/zephyr/soc/nuvoton/npcx/Kconfig"
osource "/home/pedro/zephyrproject/zephyr/soc/nordic/Kconfig"
osource "/home/pedro/zephyrproject/zephyr/soc/neorv32/Kconfig"
osource "/home/pedro/zephyrproject/zephyr/soc/native/inf_clock/Kconfig"
osource "/home/pedro/zephyrproject/zephyr/soc/microchip/miv/Kconfig"
osource "/home/pedro/zephyrproject/zephyr/soc/microchip/mec/Kconfig"
osource "/home/pedro/zephyrproject/zephyr/soc/lowrisc/opentitan/Kconfig"
osource "/home/pedro/zephyrproject/zephyr/soc/litex/litex_vexriscv/Kconfig"
osource "/home/pedro/zephyrproject/zephyr/soc/ite/ec/Kconfig"
osource "/home/pedro/zephyrproject/zephyr/soc/intel/raptor_lake/Kconfig"
osource "/home/pedro/zephyrproject/zephyr/soc/intel/lakemont/Kconfig"
osource "/home/pedro/zephyrproject/zephyr/soc/intel/intel_socfpga_std/Kconfig"
osource "/home/pedro/zephyrproject/zephyr/soc/intel/intel_socfpga/Kconfig"
osource "/home/pedro/zephyrproject/zephyr/soc/intel/intel_niosv/Kconfig"
osource "/home/pedro/zephyrproject/zephyr/soc/intel/intel_ish/Kconfig"
osource "/home/pedro/zephyrproject/zephyr/soc/intel/intel_adsp/Kconfig"
osource "/home/pedro/zephyrproject/zephyr/soc/intel/elkhart_lake/Kconfig"
osource "/home/pedro/zephyrproject/zephyr/soc/intel/atom/Kconfig"
osource "/home/pedro/zephyrproject/zephyr/soc/intel/apollo_lake/Kconfig"
osource "/home/pedro/zephyrproject/zephyr/soc/intel/alder_lake/Kconfig"
osource "/home/pedro/zephyrproject/zephyr/soc/infineon/xmc/Kconfig"
osource "/home/pedro/zephyrproject/zephyr/soc/gd/gd32/Kconfig"
osource "/home/pedro/zephyrproject/zephyr/soc/gaisler/leon3/Kconfig"
osource "/home/pedro/zephyrproject/zephyr/soc/gaisler/gr716a/Kconfig"
osource "/home/pedro/zephyrproject/zephyr/soc/espressif/Kconfig"
osource "/home/pedro/zephyrproject/zephyr/soc/ene/kb1200/Kconfig"
osource "/home/pedro/zephyrproject/zephyr/soc/efinix/sapphire/Kconfig"
osource "/home/pedro/zephyrproject/zephyr/soc/cypress/Kconfig"
osource "/home/pedro/zephyrproject/zephyr/soc/cdns/xtensa_sample_controller/Kconfig"
osource "/home/pedro/zephyrproject/zephyr/soc/cdns/dc233c/Kconfig"
osource "/home/pedro/zephyrproject/zephyr/soc/brcm/bcmvk/Kconfig"
osource "/home/pedro/zephyrproject/zephyr/soc/brcm/bcm2712/Kconfig"
osource "/home/pedro/zephyrproject/zephyr/soc/brcm/bcm2711/Kconfig"
osource "/home/pedro/zephyrproject/zephyr/soc/atmel/sam0/Kconfig"
osource "/home/pedro/zephyrproject/zephyr/soc/atmel/sam/Kconfig"
osource "/home/pedro/zephyrproject/zephyr/soc/aspeed/Kconfig"
osource "/home/pedro/zephyrproject/zephyr/soc/arm/Kconfig"
osource "/home/pedro/zephyrproject/zephyr/soc/arm/beetle/Kconfig"
osource "/home/pedro/zephyrproject/zephyr/soc/andestech/Kconfig"
osource "/home/pedro/zephyrproject/zephyr/soc/ambiq/Kconfig"
osource "/home/pedro/zephyrproject/zephyr/soc/altr/zephyr_nios2f/Kconfig"
osource "/home/pedro/zephyrproject/zephyr/soc/altr/qemu_nios2/Kconfig"
```

## Assignement04/build/Kconfig/arch/Kconfig
```kconfig
# Load arch Kconfig descriptions.
osource "/home/carlos/zephyrproject/zephyr/arch/x86/Kconfig"
osource "/home/carlos/zephyrproject/zephyr/arch/xtensa/Kconfig"
osource "/home/carlos/zephyrproject/zephyr/arch/sparc/Kconfig"
osource "/home/carlos/zephyrproject/zephyr/arch/riscv/Kconfig"
osource "/home/carlos/zephyrproject/zephyr/arch/posix/Kconfig"
osource "/home/carlos/zephyrproject/zephyr/arch/nios2/Kconfig"
osource "/home/carlos/zephyrproject/zephyr/arch/mips/Kconfig"
osource "/home/carlos/zephyrproject/zephyr/arch/arm64/Kconfig"
osource "/home/carlos/zephyrproject/zephyr/arch/arm/Kconfig"
osource "/home/carlos/zephyrproject/zephyr/arch/arc/Kconfig"
```

## Assignement04/build/Kconfig/soc/Kconfig
```kconfig
# Load Zephyr SoC Kconfig descriptions.
osource "/home/carlos/zephyrproject/zephyr/soc/xlnx/zynqmp/Kconfig"
osource "/home/carlos/zephyrproject/zephyr/soc/xlnx/zynq7000/Kconfig"
osource "/home/carlos/zephyrproject/zephyr/soc/xen/Kconfig"
osource "/home/carlos/zephyrproject/zephyr/soc/ti/simplelink/Kconfig"
osource "/home/carlos/zephyrproject/zephyr/soc/ti/lm3s6965/Kconfig"
osource "/home/carlos/zephyrproject/zephyr/soc/ti/k3/Kconfig"
osource "/home/carlos/zephyrproject/zephyr/soc/telink/tlsr/Kconfig"
osource "/home/carlos/zephyrproject/zephyr/soc/starfive/jh71xx/Kconfig"
osource "/home/carlos/zephyrproject/zephyr/soc/st/stm32/Kconfig"
osource "/home/carlos/zephyrproject/zephyr/soc/snps/qemu_arc/Kconfig"
osource "/home/carlos/zephyrproject/zephyr/soc/snps/nsim/Kconfig"
osource "/home/carlos/zephyrproject/zephyr/soc/snps/hsdk4xd/Kconfig"
osource "/home/carlos/zephyrproject/zephyr/soc/snps/hsdk/Kconfig"
osource "/home/carlos/zephyrproject/zephyr/soc/snps/emsk/Kconfig"
osource "/home/carlos/zephyrproject/zephyr/soc/snps/emsdp/Kconfig"
osource "/home/carlos/zephyrproject/zephyr/soc/snps/arc_iot/Kconfig"
osource "/home/carlos/zephyrproject/zephyr/soc/silabs/Kconfig"
osource "/home/carlos/zephyrproject/zephyr/soc/sifive/sifive_freedom/Kconfig"
osource "/home/carlos/zephyrproject/zephyr/soc/rockchip/Kconfig"
osource "/home/carlos/zephyrproject/zephyr/soc/renode/riscv_virtual/Kconfig"
osource "/home/carlos/zephyrproject/zephyr/soc/renesas/smartbond/Kconfig"
osource "/home/carlos/zephyrproject/zephyr/soc/renesas/rzt2m/Kconfig"
osource "/home/carlos/zephyrproject/zephyr/soc/renesas/rcar/Kconfig"
osource "/home/carlos/zephyrproject/zephyr/soc/renesas/ra/Kconfig"
osource "/home/carlos/zephyrproject/zephyr/soc/raspberrypi/Kconfig"
osource "/home/carlos/zephyrproject/zephyr/soc/quicklogic/eos_s3/Kconfig"
osource "/home/carlos/zephyrproject/zephyr/soc/qemu/virt_riscv/Kconfig"
osource "/home/carlos/zephyrproject/zephyr/soc/qemu/malta/Kconfig"
osource "/home/carlos/zephyrproject/zephyr/soc/openisa/rv32m1/Kconfig"
osource "/home/carlos/zephyrproject/zephyr/soc/nxp/s32/Kconfig"
osource "/home/carlos/zephyrproject/zephyr/soc/nxp/rw/Kconfig"
osource "/home/carlos/zephyrproject/zephyr/soc/nxp/mcx/Kconfig"
osource "/home/carlos/zephyrproject/zephyr/soc/nxp/lpc/Kconfig"
osource "/home/carlos/zephyrproject/zephyr/soc/nxp/layerscape/Kconfig"
osource "/home/carlos/zephyrproject/zephyr/soc/nxp/kinetis/Kconfig"
osource "/home/carlos/zephyrproject/zephyr/soc/nxp/imxrt/Kconfig"
osource "/home/carlos/zephyrproject/zephyr/soc/nxp/imx/Kconfig"
osource "/home/carlos/zephyrproject/zephyr/soc/nuvoton/numicro/Kconfig"
osource "/home/carlos/zephyrproject/zephyr/soc/nuvoton/numaker/Kconfig"
osource "/home/carlos/zephyrproject/zephyr/soc/nuvoton/npcx/Kconfig"
osource "/home/carlos/zephyrproject/zephyr/soc/nordic/Kconfig"
osource "/home/carlos/zephyrproject/zephyr/soc/neorv32/Kconfig"
osource "/home/carlos/zephyrproject/zephyr/soc/native/inf_clock/Kconfig"
osource "/home/carlos/zephyrproject/zephyr/soc/microchip/miv/Kconfig"
osource "/home/carlos/zephyrproject/zephyr/soc/microchip/mec/Kconfig"
osource "/home/carlos/zephyrproject/zephyr/soc/lowrisc/opentitan/Kconfig"
osource "/home/carlos/zephyrproject/zephyr/soc/litex/litex_vexriscv/Kconfig"
osource "/home/carlos/zephyrproject/zephyr/soc/ite/ec/Kconfig"
osource "/home/carlos/zephyrproject/zephyr/soc/intel/raptor_lake/Kconfig"
osource "/home/carlos/zephyrproject/zephyr/soc/intel/lakemont/Kconfig"
osource "/home/carlos/zephyrproject/zephyr/soc/intel/intel_socfpga_std/Kconfig"
osource "/home/carlos/zephyrproject/zephyr/soc/intel/intel_socfpga/Kconfig"
osource "/home/carlos/zephyrproject/zephyr/soc/intel/intel_niosv/Kconfig"
osource "/home/carlos/zephyrproject/zephyr/soc/intel/intel_ish/Kconfig"
osource "/home/carlos/zephyrproject/zephyr/soc/intel/intel_adsp/Kconfig"
osource "/home/carlos/zephyrproject/zephyr/soc/intel/elkhart_lake/Kconfig"
osource "/home/carlos/zephyrproject/zephyr/soc/intel/atom/Kconfig"
osource "/home/carlos/zephyrproject/zephyr/soc/intel/apollo_lake/Kconfig"
osource "/home/carlos/zephyrproject/zephyr/soc/intel/alder_lake/Kconfig"
osource "/home/carlos/zephyrproject/zephyr/soc/infineon/cat3/Kconfig"
osource "/home/carlos/zephyrproject/zephyr/soc/infineon/cat1a/Kconfig"
osource "/home/carlos/zephyrproject/zephyr/soc/gd/gd32/Kconfig"
osource "/home/carlos/zephyrproject/zephyr/soc/gaisler/leon3/Kconfig"
osource "/home/carlos/zephyrproject/zephyr/soc/gaisler/gr716a/Kconfig"
osource "/home/carlos/zephyrproject/zephyr/soc/espressif/Kconfig"
osource "/home/carlos/zephyrproject/zephyr/soc/ene/kb1200/Kconfig"
osource "/home/carlos/zephyrproject/zephyr/soc/efinix/sapphire/Kconfig"
osource "/home/carlos/zephyrproject/zephyr/soc/cdns/xtensa_sample_controller/Kconfig"
osource "/home/carlos/zephyrproject/zephyr/soc/cdns/dc233c/Kconfig"
osource "/home/carlos/zephyrproject/zephyr/soc/brcm/bcmvk/Kconfig"
osource "/home/carlos/zephyrproject/zephyr/soc/brcm/bcm2712/Kconfig"
osource "/home/carlos/zephyrproject/zephyr/soc/brcm/bcm2711/Kconfig"
osource "/home/carlos/zephyrproject/zephyr/soc/atmel/sam0/Kconfig"
osource "/home/carlos/zephyrproject/zephyr/soc/atmel/sam/Kconfig"
osource "/home/carlos/zephyrproject/zephyr/soc/aspeed/Kconfig"
osource "/home/carlos/zephyrproject/zephyr/soc/arm/Kconfig"
osource "/home/carlos/zephyrproject/zephyr/soc/arm/beetle/Kconfig"
osource "/home/carlos/zephyrproject/zephyr/soc/andestech/Kconfig"
osource "/home/carlos/zephyrproject/zephyr/soc/ambiq/Kconfig"
osource "/home/carlos/zephyrproject/zephyr/soc/altr/zephyr_nios2f/Kconfig"
osource "/home/carlos/zephyrproject/zephyr/soc/altr/qemu_nios2/Kconfig"
```
